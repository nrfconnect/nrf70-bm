## west.yml
```yaml
# Copyright (c) 2024 Nordic Semiconductor ASA
# SPDX-License-Identifier: BSD-3-Clause

manifest:
  remotes:
    - name: zephyr
      url-base: https://github.com/zephyrproject-rtos
    - name: ncs
      url-base: https://github.com/nrfconnect
  defaults:
    remote: zephyr
  projects:
    # For testing with nRF boards
    - name: zephyr
      repo-path: zephyr
      revision: v4.1.0
      import:
        name-allowlist:
          - hal_nordic
          - picolibc
          - cmsis
          - cmsis-dsp
          - cmsis-nn
          - trusted-firmware-m
          - mbedtls
          - mcuboot
        name-blacklist:
          - nrf_wifi
    # nRF70 Wi-Fi OSAL library
    - name: nrf_wifi
      repo-path: nrf_wifi
      revision: 8e3a55124fa5e93f7a8fba5f5338e9d5a86d01fb
      path: modules/lib/nrf_wifi
    # nRF70 Wi-Fi firmware blobs (without west blobs fetch)
    - name: nrfxlib
      remote: ncs
      repo-path: sdk-nrfxlib
      revision: c2efece046154752d9b926bc9e319fd665fa371d
      path: nrfxlib
```
