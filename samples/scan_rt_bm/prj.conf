## CMakeLists.txt
```
#
# Copyright (c) 2024 Nordic Semiconductor ASA
#
# SPDX-License-Identifier: BSD-3-Clause
#

cmake_minimum_required(VERSION 3.20.0)

find_package(Zephyr REQUIRED HINTS $ENV{ZEPHYR_BASE})
project(nrf70_scan_rt_bm)

set(NRF70_BM_DIR ../../nrf70_bm_lib)
set(NRF_WIFI_DIR ${ZEPHYR_NRF_WIFI_MODULE_DIR})

target_compile_definitions(app PRIVATE
	-DCONFIG_NRF70_BM_RADIO_TEST
	-DNRF70_RADIO_TEST # OSAL
  -DCONFIG_NRF70_BM_SCAN_ONLY
  -DNRF70_SCAN_ONLY # OSAL
)

target_include_directories(app PRIVATE
  src
  ${NRF70_BM_DIR}/include
	${NRF_WIFI_DIR}/utils/inc
	${NRF_WIFI_DIR}/os_if/inc
	${NRF_WIFI_DIR}/bus_if/bus/qspi/inc
	${NRF_WIFI_DIR}/bus_if/bal/inc
	${NRF_WIFI_DIR}/fw_load/mips/fw/inc
	${NRF_WIFI_DIR}/hw_if/hal/inc
	${NRF_WIFI_DIR}/hw_if/hal/inc/fw
	${NRF_WIFI_DIR}/fw_if/umac_if/inc/fw
	${NRF_WIFI_DIR}/fw_if/umac_if/inc/
)

target_sources(
  app
  PRIVATE
  src/main.c
  src/utils.c
)

if(DEFINED CONFIG_NRF70_DEBUG_SHELL)
  target_include_directories(app PRIVATE
    $<TARGET_PROPERTY:nrf-wifi-osal,INTERFACE_INCLUDE_DIRECTORIES>
  )

endif()

target_link_libraries(app PRIVATE nrf70-bm-lib)
```

## Kconfig
```
#
# Copyright (c) 2025 Nordic Semiconductor
#
# SPDX-License-Identifier: BSD-3-Clause
#

menu "nRF70 BM scan and radio test combo sample configuration"

menu "Zephyr Kernel"
source "Kconfig.zephyr"
endmenu

module = NR70_SCAN_RT_BM_SAMPLE
module-str = nRF70 BM scan and radio test combo sample
source "${ZEPHYR_BASE}/subsys/logging/Kconfig.template.log_config"

config WIFI_MAC_ADDRESS
	string "WiFi MAC address"
	default "F6:CE:36:00:00:01"
	help
		Wi-Fi MAC address to be used by the sample. If not set, the sample will
		use the default MAC address (locally administrative). This is only used
		when the nRF7002 OTP is not programmed with a MAC address.

config WIFI_SCAN_INTERVAL_S
	int "Scan interval (seconds)"
	default 10
	help
	  Specifies the scan interval in seconds.

config WIFI_SCAN_BANDS_LIST
	string "Frequency bands to scan"
	default "2" if WIFI_SCAN_PROFILE_2_4GHz_ACTIVE || WIFI_SCAN_PROFILE_2_4GHz_PASSIVE || WIFI_SCAN_PROFILE_2_4GHz_NON_OVERLAP_CHAN
	default "5" if WIFI_SCAN_PROFILE_5GHz_ACTIVE || WIFI_SCAN_PROFILE_5GHz_PASSIVE || WIFI_SCAN_PROFILE_5GHz_NON_DFS_CHAN
	default "2,5" if WIFI_SCAN_PROFILE_2_4GHz_NON_OVERLAP_AND_5GHz_NON_DFS_CHAN
	default ""
	help
	  Specifies the frequency bands to scan, as follows:
	  2 - 2.4 GHz,
	  5 - 5 GHz,
	  6 - 6 GHz,
	  "" - All bands allowed by the regulatory domain.
	  Multiple bands can be specified as comma separated band values.
	  Only regulatory domain permitted values are allowed.

config WIFI_SCAN_CHAN_LIST
	string "Channel list for scan"
	default "2:1,6,11" if WIFI_SCAN_PROFILE_2_4GHz_NON_OVERLAP_CHAN
	default "5:36,40,44,48,149,153,157,161,165" if WIFI_SCAN_PROFILE_5GHz_NON_DFS_CHAN
	default "2:1,6,11_5:36,40,44,48,149,153,157,161,165" if WIFI_SCAN_PROFILE_2_4GHz_NON_OVERLAP_AND_5GHz_NON_DFS_CHAN
	default ""
	help
	  Specifies the list of channels used to perform scan.

config WIFI_SCAN_DWELL_TIME_ACTIVE
	int "Active scan dwell time"
	default 50
	range 5 1000
	help
	  Active scan dwell time (in ms) per channel.

config WIFI_SCAN_DWELL_TIME_PASSIVE
	int "Passive scan dwell time"
	default 130
	range 10 1000
	help
	  Passive scan dwell time (in ms) per channel.

config WIFI_SCAN_TYPE_ACTIVE
	bool "Active scan"
	help
	  Enable this profile to do active scan where allowed.

config WIFI_SCAN_TYPE_PASSIVE
	bool "Passive scan"
	help
	  Enable this profile to do passive scan on all channels.

choice
	prompt "Choose a WiFi Scan Profile"

config WIFI_SCAN_PROFILE_DEFAULT
	bool "Scan in all bands and channels"
	help
	  Enable this profile to do Wi-Fi scan in all supported bands and channels.

config WIFI_SCAN_PROFILE_ACTIVE
	bool "Active scan"
	select WIFI_SCAN_TYPE_ACTIVE
	help
	  Enable this profile to do active scan where allowed.

config WIFI_SCAN_PROFILE_PASSIVE
	bool "Passive scan"
	select WIFI_SCAN_TYPE_PASSIVE
	help
	  Enable this profile to do passive scan on all channels.

config WIFI_SCAN_PROFILE_2_4GHz_ACTIVE
	bool "Scan in the 2.4 GHz band using active scan"
	select WIFI_SCAN_TYPE_ACTIVE
	help
	  Enable this profile to scan in the 2.4 GHz band using active scanning where allowed.

config WIFI_SCAN_PROFILE_2_4GHz_PASSIVE
	bool "Scan in the 2.4 GHz band using passive scan"
	select WIFI_SCAN_TYPE_PASSIVE
	help
	  Enable this profile to scan in the 2.4 GHz band using passive scanning on all channels.

config WIFI_SCAN_PROFILE_5GHz_ACTIVE
	bool "Scan in the 5 GHz band using active scan"
	select WIFI_SCAN_TYPE_ACTIVE
	help
	  Enable this profile to scan in the 5 GHz band using active scanning where allowed.

config WIFI_SCAN_PROFILE_5GHz_PASSIVE
	bool "Scan in the 5 GHz band using passive scan"
	select WIFI_SCAN_TYPE_PASSIVE
	help
	  Enable this profile to scan in the 5 GHz band using passive scanning on all channels.

config WIFI_SCAN_PROFILE_2_4GHz_NON_OVERLAP_CHAN
	bool "Scan only non-overlapping channels"
	help
	  Enable this profile to scan only non-overlapping channels (1, 6, 11)
	  in the 2.4 GHz band.

config WIFI_SCAN_PROFILE_5GHz_NON_DFS_CHAN
	bool "Scan only non-DFS channels"
	help
	  Enable this profile to scan only non-DFS channels (36, 40, 44,
	  48, 149, 153, 157, 161, 165) in the 5 GHz band.

config WIFI_SCAN_PROFILE_2_4GHz_NON_OVERLAP_AND_5GHz_NON_DFS_CHAN
	bool "Scan only non-overlapping and non-DFS channels"
	help
	  Enable this profile to scan only non-overlapping channels
	  (1, 6, 11) in the 2.4 GHz band and non-DFS channels (36, 40, 44,
	  48, 149, 153, 157, 161, 165) in the 5 GHz band.

endchoice

config WIFI_REG_DOMAIN
	string "Regulatory domain"
	default "00"
	help
	  Specifies the regulatory domain to be used for the scan.

config WIFI_REG_DOMAIN_2
	string "Regulatory domain"
	default "IN"
	help
	  Specifies the second regulatory domain to be used for the scan.
	  The code will keep toggling between the two regulatory domains,
	  primarily to test the regulatory domain change feature.

if WIFI_SCAN_PROFILE_5GHz_NON_DFS_CHAN || WIFI_SCAN_PROFILE_2_4GHz_NON_OVERLAP_AND_5GHz_NON_DFS_CHAN
config WIFI_MGMT_SCAN_CHAN_MAX_MANUAL
	default 12
endif

config NRF70_DEBUG_SHELL
	bool "Enable debug shell"
	help
	  Enable debug shell for the sample.
endmenu
```

## sample.yaml
```
sample:
  description: Wi-Fi scan and radio test combo sample
    application
  name: Wi-Fi scan and radio test combo
tests:
  sample.nrf7002.scan_rt_bm:
    sysbuild: true
    build_only: true
    integration_platforms:
      - nrf7002dk/nrf5340/cpuapp
    platform_allow: nrf7002dk/nrf5340/cpuapp
    tags: ci_build sysbuild
  sample.nrf7001.scan_rt_bm:
    sysbuild: true
    build_only: true
    integration_platforms:
      - nrf7002dk/nrf5340/cpuapp/nrf7001
    platform_allow: nrf7002dk/nrf5340/cpuapp/nrf7001
    tags: ci_build sysbuild
    skip: true
  sample.nrf7002.scan_rt_bm_combo:
    sysbuild: true
    build_only: true
    extra_args: CONFIG_NRF70_RADIO_TEST_COMBO=y
    integration_platforms:
      - nrf7002dk/nrf5340/cpuapp
    platform_allow: nrf7002dk/nrf5340/cpuapp
    tags: ci_build sysbuild
  sample.nrf7002_eks.scan_rt_bm:
    sysbuild: true
    build_only: true
    extra_args: SHIELD=nrf7002ek
    integration_platforms:
      - nrf5340dk/nrf5340/cpuapp
      - nrf52840dk/nrf52840
    platform_allow: nrf5340dk/nrf5340/cpuapp nrf52840dk/nrf52840
    tags: ci_build sysbuild
  sample.nrf7001_eks.scan_rt_bm:
    sysbuild: true
    build_only: true
    extra_args: SHIELD=nrf7002ek_nrf7001
    integration_platforms:
      - nrf5340dk/nrf5340/cpuapp
      - nrf52840dk/nrf52840
    platform_allow: nrf5340dk/nrf5340/cpuapp nrf52840dk/nrf52840
    tags: ci_build sysbuild
  sample.nrf7000_eks.scan_rt_bm:
    sysbuild: true
    build_only: true
    extra_args: SHIELD=nrf7002ek_nrf7000
    integration_platforms:
      - nrf9160dk/nrf9160/ns
    platform_allow: nrf9160dk/nrf9160/ns
    tags: ci_build sysbuild
  sample.nrf7002_eb.thingy53.scan_rt_bm:
    sysbuild: true
    build_only: true
    extra_args: radio_test_SHIELD=nrf7002eb
    integration_platforms:
      - thingy53/nrf5340/cpuapp
    platform_allow: thingy53/nrf5340/cpuapp
    tags: ci_build sysbuild
  sample.thingy91x_nrf7002.scan_rt_bm:
    sysbuild: true
    build_only: true
    platform_allow: thingy91x/nrf9151/ns
    tags: ci_build sysbuild
```

## prj.conf
```kconfig
#
# Copyright (c) 2024 Nordic Semiconductor ASA
#
# SPDX-License-Identifier: BSD-3-Clause
#

CONFIG_NRF70_BM_LIB=y
CONFIG_MAIN_STACK_SIZE=4200

# Debugs
CONFIG_THREAD_MONITOR=y
CONFIG_LOG=y
CONFIG_LOG_MODE_IMMEDIATE=y

CONFIG_NRF70_BM_RADIO_TEST=y
#64K memory needed for IQ sample captures.
CONFIG_HEAP_MEM_POOL_SIZE=98304
```

## overlay-shell.conf
```kconfig
#
# Copyright (c) 2024 Nordic Semiconductor ASA
#
# SPDX-License-Identifier: BSD-3-Clause
#

CONFIG_SHELL=y
CONFIG_SHELL_BACKEND_SERIAL=y
CONFIG_SHELL_STACK_SIZE=4200
CONFIG_NRF70_DEBUG_SHELL=y
CONFIG_SYS_HEAP_RUNTIME_STATS=y
CONFIG_LOG=y
CONFIG_LOG_MODE_IMMEDIATE=y
CONFIG_PRINTK=y
```

## src/main.c
```c
/*
 * Copyright (c) 2025 Nordic Semiconductor ASA
 *
 * SPDX-License-Identifier: BSD-3-Clause
 */

/** @file
 * @brief WiFi scan and radio test combo sample application using nRF70 Bare Metal library.
 */

#include <stdlib.h>
#include <errno.h>
#include <stdio.h>
#include <time.h>

/* Only for k_sleep() */
#include <zephyr/kernel.h>
#include "system/nrf70_bm_lib.h"
#include "radio_test/nrf70_bm_lib.h"
#include "utils.h"

extern struct nrf70_bm_rt_wifi_drv_priv nrf70_bm_rt_priv;
struct nrf70_bm_rt_wifi_ctx *ctx = &nrf70_bm_rt_priv.rpu_ctx_bm;

#define CHECK_RET(func) do { \
	ret = func; \
	if (ret) { \
		printf("Error: %d\n", ret); \
		goto cleanup; \
	} \
} while (0)

bool debug_enabled;

#define debug_print(fmt, ...) \
	do {if (debug_enabled) printf(fmt, ##__VA_ARGS__); } while (0)

unsigned int scan_result_cnt;
bool is_scan_done;

void scan_result_cb(struct nrf70_bm_sys_scan_result *entry)
{
	unsigned char bssid_str[18];

	if (!entry)
	{
		is_scan_done = true;
		return;
	}

	if (++scan_result_cnt == 1) {
		printf("\n%-4s | %-32s | %-13s | %-4s | %-15s | %-17s | %-8s\n",
		   "Num", "SSID", "Chan (Band)", "RSSI", "Security", "BSSID", "MFP");
	}

	nrf70_bm_sys_mac_txt(entry->bssid, bssid_str, sizeof(bssid_str));
	printf("%-4d | %-32s | %-4u (%-6s) | %-4d | %-15s | %-17s | %-8s\n",
		   scan_result_cnt, entry->ssid, entry->channel,
		   nrf70_bm_sys_band_txt(entry->band),
		   entry->rssi,
		   nrf70_bm_sys_security_txt(entry->security),
		   bssid_str,
		   nrf70_bm_sys_mfp_txt(entry->mfp));
}
static int prepare_scan_params(struct nrf70_bm_sys_scan_params *params)
{
	int band_str_len = sizeof(CONFIG_WIFI_SCAN_BANDS_LIST);

	if (band_str_len - 1) {
		char *buf = malloc(band_str_len);

		if (!buf) {
			printf("Malloc Failed\n");
			return -EINVAL;
		}
		strcpy(buf, CONFIG_WIFI_SCAN_BANDS_LIST);
		if (wifi_utils_parse_scan_bands(buf, &params->bands)) {
			printf("Incorrect value(s) in CONFIG_WIFI_SCAN_BANDS_LIST: %s\n",
					CONFIG_WIFI_SCAN_BANDS_LIST);
			free(buf);
			return -ENOEXEC;
		}
		free(buf);
	}

	if (sizeof(CONFIG_WIFI_SCAN_CHAN_LIST) - 1) {
		if (wifi_utils_parse_scan_chan(CONFIG_WIFI_SCAN_CHAN_LIST,
						(struct nrf70_bm_sys_band_channel *)params->band_chan,
						ARRAY_SIZE(params->band_chan))) {
			printf("Incorrect value(s) in CONFIG_WIFI_SCAN_CHAN_LIST: %s\n",
					CONFIG_WIFI_SCAN_CHAN_LIST);
			return -ENOEXEC;
		}
	}

	params->dwell_time_passive = CONFIG_WIFI_SCAN_DWELL_TIME_PASSIVE;
	params->dwell_time_active = CONFIG_WIFI_SCAN_DWELL_TIME_ACTIVE;

	if (IS_ENABLED(CONFIG_WIFI_SCAN_TYPE_PASSIVE)) {
		params->scan_type = NRF70_SCAN_TYPE_PASSIVE;
	} else{
		params->scan_type = NRF70_SCAN_TYPE_ACTIVE;
	}

	return 0;
}

static int nrf70_bm_rt_conf_init(struct rpu_conf_params *conf_params)
{
	int ret = -1;
	enum nrf_wifi_status status = NRF_WIFI_STATUS_FAIL;
	unsigned char country_code[NRF_WIFI_COUNTRY_CODE_LEN] = { 0 };

	/* Check and save regulatory country code currently set */
	if (strlen(conf_params->country_code)) {
	  memcpy(country_code, conf_params->country_code, NRF_WIFI_COUNTRY_CODE_LEN);
	}

	memset(conf_params, 0, sizeof(*conf_params));

	/* Initialize values which are other than 0 */
	conf_params->op_mode = RPU_OP_MODE_RADIO_TEST;

	status = nrf_wifi_rt_fmac_rf_params_get(ctx->rpu_ctx,
						(struct nrf_wifi_phy_rf_params *)conf_params->rf_params);
	if (status != NRF_WIFI_STATUS_SUCCESS) {
	  goto out;
	}

	conf_params->tx_pkt_nss = 1;
	conf_params->tx_pkt_gap_us = 0;
	conf_params->tx_power = MAX_TX_PWR_SYS_TEST;
	conf_params->chan.primary_num = 1;
	conf_params->tx_mode = 1;
	conf_params->tx_pkt_num = -1;
	conf_params->tx_pkt_len = 1400;
	conf_params->tx_pkt_preamble = 0;
	conf_params->tx_pkt_rate = 6;
	conf_params->he_ltf = 2;
	conf_params->he_gi = 2;
	conf_params->aux_adc_input_chain_id = 1;
	conf_params->ru_tone = 26;
	conf_params->ru_index = 1;
	conf_params->tx_pkt_cw = 15;
	conf_params->phy_calib = NRF_WIFI_DEF_PHY_CALIB;

	/* Store back the currently set country code */
	if (strlen(country_code)) {
		memcpy(conf_params->country_code,
		       country_code,
		       NRF_WIFI_COUNTRY_CODE_LEN);
	} else {
		memcpy(conf_params->country_code,
		       "00",
		       NRF_WIFI_COUNTRY_CODE_LEN);
	}

	ret = 0;
out:
	return ret;
}

static int nrf_wifi_radio_test_set_tx(struct rpu_conf_params *conf_params,
				      bool start)
{
	enum nrf_wifi_status status = NRF_WIFI_STATUS_FAIL;

	if (start) {
		conf_params->tx = 1;
	} else {
		conf_params->tx = 0;
	}
	status = nrf_wifi_rt_fmac_prog_tx(ctx->rpu_ctx, conf_params);
	if (status != NRF_WIFI_STATUS_SUCCESS) {
		printf("Programming TX failed\n");
		return -ENOEXEC;
	}

	return 0;
}


static int nrf70_bm_rt_stats_get(void)
{
	enum nrf_wifi_status status = NRF_WIFI_STATUS_FAIL;
	struct rpu_rt_op_stats stats;

	memset(&stats, 0, sizeof(stats));

	status = nrf_wifi_rt_fmac_stats_get(ctx->rpu_ctx,
					    ctx->conf_params.op_mode,
					    &stats);

	if (status != NRF_WIFI_STATUS_SUCCESS) {
		printf("nrf_wifi_fmac_stats_get failed\n");
		return -ENOEXEC;
	}

	printf("************* PHY STATS ***********\n");

	printf("rssi_avg = %d dBm\n",
	       stats.fw.phy.rssi_avg);

	printf("ofdm_crc32_pass_cnt=%d\n",
	       stats.fw.phy.ofdm_crc32_pass_cnt);

	printf("ofdm_crc32_fail_cnt=%d\n",
	       stats.fw.phy.ofdm_crc32_fail_cnt);

	printf("dsss_crc32_pass_cnt=%d\n",
	       stats.fw.phy.dsss_crc32_pass_cnt);

	printf("dsss_crc32_fail_cnt=%d\n",
	       stats.fw.phy.dsss_crc32_fail_cnt);

	return 0;
}


int main(void)
{
	struct nrf70_bm_sys_scan_params scan_params = { 0 };
	struct nrf70_bm_regulatory_info reg_info = { 0 };
	bool sys_init = false;
	bool rt_init = false;
	int ret = -1;
	int i;

	for (i = 0; i < 2; i++) {
		/*
		 * Radio test operation
		 */
		/* Initialize the WiFi module in the radio test mode of operation */
		printf("\n\nWi-Fi radio test functionality using nRF70 Bare Metal library\n\n");

		if (i == 0) {
			memcpy(reg_info.country_code,
			       CONFIG_WIFI_REG_DOMAIN,
			       2);
		} else {
			memcpy(reg_info.country_code,
			       CONFIG_WIFI_REG_DOMAIN_2,
			       2);
		}

		reg_info.force = true;

		CHECK_RET(nrf70_bm_rt_init(&reg_info));
		rt_init = true;

		CHECK_RET(nrf70_bm_rt_conf_init(&ctx->conf_params));

		printf("Starting transmit\n");
		/* Start transmit*/
		CHECK_RET(nrf_wifi_radio_test_set_tx(&ctx->conf_params, true));

		k_sleep(K_MSEC(5000));

		printf("Stopping transmit\n");
		/* Stop transmit */
		CHECK_RET(nrf_wifi_radio_test_set_tx(&ctx->conf_params, false));

		printf("Getting stats\n");
		CHECK_RET(nrf70_bm_rt_stats_get());

		printf("\n\nDeinitializing radio test functionality\n\n");

		nrf70_bm_rt_deinit();
		rt_init = false;

		/*
		 * Scan operation
		 */
		printf("\n\nSwitching to Wi-Fi scan functionality using nRF70 Bare Metal library\n");

		/* Initialize the WiFi module in the System mode of operation */
		CHECK_RET(nrf70_bm_sys_init(NULL, &reg_info));
		sys_init = true;

		printf("Scanning for WiFi networks...\n");

		/* Prepare scan parameters */
		CHECK_RET(prepare_scan_params(&scan_params));

		/* Start scanning for WiFi networks */
		is_scan_done = false;

		printf("Starting scan\n");
		CHECK_RET(nrf70_bm_sys_scan_start(&scan_params, scan_result_cb));

		/* Wait for the scan to complete or timeout */
		unsigned int timeout = 30000;
		while (!is_scan_done && timeout > 0) {
			/* Wait for the scan to complete */
			k_sleep(K_MSEC(500));
			timeout -= 500;
		}

		if (!is_scan_done) {
			printf("Scan timeout\n");
		} else {
			scan_result_cnt = 0;
			printf("Scan complete\n");
		}

		/* Clean up the WiFi module in the system mode of operation */
		printf("\n\nDeinitializing scan functionality\n\n");
		nrf70_bm_sys_deinit();
		sys_init = false;
	}

	ret = 0;
cleanup:
	if (sys_init) {
		nrf70_bm_sys_deinit();
		sys_init = false;
	}

	if (rt_init) {
		nrf70_bm_rt_deinit();
		rt_init = false;
	}

	if (ret) {
		printf("Exiting WiFi scan and radio test combo sample application with error: %d\n", ret);
	}

	return ret;
}
```

## src/utils.c
```c
/*
 * Copyright (c) 2024 Nordic Semiconductor ASA
 *
 * SPDX-License-Identifier: BSD-3-Clause
 */

/** @file
 * @brief Wi-Fi utility functions.
 */

#include "utils.h"

#define NRF70_MAX_BAND_STR_LEN 3
#define NRF70_MAX_CHAN_STR_LEN 4
#define NRF70_BAND_STR_SIZE_MAX 8
#define NRF70_SCAN_MAX_BSS_CNT 65535

/* Ensure 'strtok_r' is available even with -std=c99. */
char *strtok_r(char *str, const char *delim, char **saveptr);

static const uint8_t valid_5g_chans_20mhz[] = {32, 36, 40, 44, 48, 52, 56, 60, 64, 68, 96, 100,
	104, 108, 112, 116, 120, 124, 128, 132, 136, 140, 144, 149, 153, 157, 159, 161,
	163, 165, 167, 169, 171, 173, 175, 177};

static enum nrf70_bm_sys_freq_bands wifi_utils_map_band_str_to_idx(char *band_str)
{
	enum nrf70_bm_sys_freq_bands band = NRF70_FREQ_BAND_UNKNOWN;

	if (!strcmp(band_str, "2")) {
		band = NRF70_FREQ_BAND_2_4_GHZ;
	} else if (!strcmp(band_str, "5")) {
		band = NRF70_FREQ_BAND_5_GHZ;
	} else if (!strcmp(band_str, "6")) {
		band = NRF70_FREQ_BAND_6_GHZ;
	}

	return band;
}


bool wifi_utils_validate_chan_2g(uint16_t chan)
{
	if ((chan >= 1) && (chan <= 14)) {
		return true;
	}

	return false;
}


bool wifi_utils_validate_chan_5g(uint16_t chan)
{
	uint16_t i;

	for (i = 0; i < ARRAY_SIZE(valid_5g_chans_20mhz); i++) {
		if (chan == valid_5g_chans_20mhz[i]) {
			return true;
		}
	}

	return false;
}


bool wifi_utils_validate_chan_6g(uint16_t chan)
{
	if (((chan >= 1) && (chan <= 233) && (!((chan - 1) % 4))) ||
	    (chan == 2)) {
		return true;
	}

	return false;
}


bool wifi_utils_validate_chan(uint8_t band,
			      uint16_t chan)
{
	bool result = false;

	switch (band) {
	case NRF70_FREQ_BAND_2_4_GHZ:
		result = wifi_utils_validate_chan_2g(chan);
		break;
	case NRF70_FREQ_BAND_5_GHZ:
		result = wifi_utils_validate_chan_5g(chan);
		break;
	case NRF70_FREQ_BAND_6_GHZ:
		result = wifi_utils_validate_chan_6g(chan);
		break;
	default:
		printf("Unknown band: %d", band);
		break;
	}

	return result;
}


static int wifi_utils_get_all_chans_in_range(uint8_t chan_start,
		uint8_t chan_end,
		struct nrf70_bm_sys_band_channel *band_chan,
		uint8_t band_idx,
		uint8_t *chan_idx)
{
	uint8_t i;
	bool start = false;
	bool end = false;
	uint8_t idx;

	if (!wifi_utils_validate_chan(band_idx, chan_start)) {
		printf("Invalid channel value %d in band %d", chan_start, band_idx);
		return -EINVAL;
	}

	if (!wifi_utils_validate_chan(band_idx, chan_end)) {
		printf("Invalid channel value %d in band %d", chan_end, band_idx);
		return -EINVAL;
	}

	if (chan_end < chan_start) {
		printf("Channel range end (%d) cannot be less than start (%d)",
			chan_end,
			chan_start);
		return -EINVAL;
	}

	switch (band_idx) {
	case NRF70_FREQ_BAND_2_4_GHZ:
		idx = *chan_idx;

		for (i = chan_start+1; i <= chan_end; i++) {
			band_chan[idx].band = band_idx;
			band_chan[idx].channel = i;
			idx++;
		}

		*chan_idx = idx;

		break;
	case NRF70_FREQ_BAND_5_GHZ:
		idx = *chan_idx;

		for (i = 0; i < ARRAY_SIZE(valid_5g_chans_20mhz); i++) {
			if (valid_5g_chans_20mhz[i] == chan_start) {
				start = true;
				continue;
			}

			if (valid_5g_chans_20mhz[i] == chan_end) {
				end = true;
			}

			if (start) {
				band_chan[idx].band = band_idx;
				band_chan[idx].channel = valid_5g_chans_20mhz[i];
				idx++;
			}

			if (end) {
				*chan_idx = idx;
				break;
			}
		}

		break;
	case NRF70_FREQ_BAND_6_GHZ:
		idx = *chan_idx;

		i = chan_start+1;

		while (i <= chan_end) {
			band_chan[idx].band = band_idx;
			band_chan[idx].channel = i;
			idx++;

			if (i == 1) {
				i++;
			} else if (i == 2) {
				i += 3;
			} else {
				i += 4;
			}
		}

		*chan_idx = idx;
		break;
	default:
		printf("Unknown band value: %d", band_idx);
		return -EINVAL;
	}

	return 0;
}


static int wifi_utils_validate_chan_str(char *chan_str)
{
	uint8_t i;

	if ((!chan_str) || (!strlen(chan_str))) {
		printf("Null or empty channel string\n");
		return -EINVAL;
	}

	for (i = 0; i < strlen(chan_str); i++) {
		if (!isdigit((int)chan_str[i])) {
			printf("Invalid character in channel string %c\n", chan_str[i]);
			return -EINVAL;
		}
	}

	return 0;
}


int wifi_utils_parse_scan_bands(char *scan_bands_str, uint8_t *band_map)
{
	char parse_str[NRF70_BAND_STR_SIZE_MAX + 1];
	char *band_str = NULL;
	char *ctx = NULL;
	enum nrf70_bm_sys_freq_bands band = NRF70_FREQ_BAND_UNKNOWN;
	int len;

	if (!scan_bands_str) {
		return -EINVAL;
	}

	len = strlen(scan_bands_str);

	if (len > NRF70_BAND_STR_SIZE_MAX) {
		printf("Band string (%s) size (%d) exceeds maximum allowed value (%d)",
			scan_bands_str,
			len,
			NRF70_BAND_STR_SIZE_MAX);
		return -EINVAL;
	}

	strncpy(parse_str, scan_bands_str, sizeof(parse_str) - 1);
	parse_str[sizeof(parse_str) - 1] = '\0';

	band_str = strtok_r(parse_str, ",", &ctx);

	while (band_str) {
		band = wifi_utils_map_band_str_to_idx(band_str);

		if (band == NRF70_FREQ_BAND_UNKNOWN) {
			printf("Invalid band value: %s", band_str);
			return -EINVAL;
		}

		*band_map |= (1 << band);

		band_str = strtok_r(NULL, ",", &ctx);
	}

	return 0;
}

int wifi_utils_parse_scan_ssids(char *scan_ssids_str,
				const char *ssids[],
				uint8_t num_ssids)
{
	int len;

	if (!scan_ssids_str) {
		return -EINVAL;
	}

	len = strlen(scan_ssids_str);
	if (len > NR70_SCAN_SSID_MAX_LEN) {
		printf("SSID string (%s) size (%d) exceeds maximum allowed value (%d)",
			scan_ssids_str,
			len,
			NR70_SCAN_SSID_MAX_LEN);
		return -EINVAL;
	}

	for (int i = 0; i < num_ssids; i++) {
		if (ssids[i] != NULL) {
			continue;
		}
		ssids[i] = scan_ssids_str;
		return 0;
	}

	printf("Exceeded maximum allowed SSIDs (%d)", num_ssids);
	return 0;
}


int wifi_utils_parse_scan_chan(char *scan_chan_str,
			       struct nrf70_bm_sys_band_channel *band_chan,
			       uint8_t max_channels)
{
	char band_str[NRF70_MAX_BAND_STR_LEN] = {0};
	char chan_str[NRF70_MAX_CHAN_STR_LEN] = {0};
	enum nrf70_bm_sys_freq_bands band = NRF70_FREQ_BAND_UNKNOWN;
	uint16_t band_str_start_idx = 0;
	uint16_t chan_str_start_idx = 0;
	uint8_t chan_idx = 0;
	uint8_t chan_start = 0;
	uint8_t chan_val = 0;
	uint16_t i = 0;
	bool valid_band = false;
	bool valid_chan = false;

	while (scan_chan_str[i] != '\0') {
		if (scan_chan_str[i] != ':') {
			i++;
			continue;
		}

		if (((i - band_str_start_idx) <= 0) ||
		    ((i - band_str_start_idx) > NRF70_MAX_BAND_STR_LEN)) {
			printf("Invalid band value %s",
				&scan_chan_str[band_str_start_idx]);
			return -EINVAL;
		}

		strncpy(band_str,
			&scan_chan_str[band_str_start_idx],
			(i - band_str_start_idx));

		band = wifi_utils_map_band_str_to_idx(band_str);

		if (band == NRF70_FREQ_BAND_UNKNOWN) {
			printf("Unsupported band value: %s", band_str);
			return -EINVAL;
		}

		i++;
		chan_str_start_idx = i;
		valid_band = true;

		while (1) {
			if ((scan_chan_str[i] != ',') &&
			    (scan_chan_str[i] != '_') &&
			    (scan_chan_str[i] != '-') &&
			    (scan_chan_str[i] != '\0')) {
				i++;
				continue;
			}

			if ((i - chan_str_start_idx) >
			    NRF70_MAX_CHAN_STR_LEN) {
				printf("Invalid chan value %s",
					&scan_chan_str[chan_str_start_idx]);
				return -EINVAL;
			}

			strncpy(chan_str,
				&scan_chan_str[chan_str_start_idx],
				(i - chan_str_start_idx));

			if (wifi_utils_validate_chan_str(chan_str)) {
				printf("Channel string validation failed");
				return -EINVAL;
			}

			chan_val = atoi(chan_str);

			memset(chan_str, 0, sizeof(chan_str));

			if (chan_start) {
				if (wifi_utils_get_all_chans_in_range(chan_start,
								      chan_val,
								      band_chan,
								      band,
								      &chan_idx)) {
					printf("Channel range invalid");
					return -EINVAL;
				}

				if (chan_idx > max_channels) {
					printf("Too many channels specified (%d)", max_channels);
					return -EINVAL;
				}
				chan_start = 0;
			} else {
				if (!wifi_utils_validate_chan(band,
							      chan_val)) {
					printf("Invalid channel %d", chan_val);
					return -EINVAL;
				}
				if (chan_idx == max_channels) {
					printf("Too many channels specified (%d)", max_channels);
					return -EINVAL;
				}

				band_chan[chan_idx].band = band;
				band_chan[chan_idx].channel = chan_val;
				chan_idx++;
			}

			valid_chan = true;

			if (scan_chan_str[i] == '_') {
				band_str_start_idx = ++i;
				break;
			} else if (scan_chan_str[i] == ',') {
				chan_str_start_idx = ++i;
			} else if (scan_chan_str[i] == '-') {
				chan_start = chan_val;
				chan_str_start_idx = ++i;
			} else if (scan_chan_str[i] == '\0') {
				break;
			}
		}
	}

	if (!valid_band) {
		printf("No valid band found");
		return -EINVAL;
	}

	if (!valid_chan) {
		printf("No valid channel found");
		return -EINVAL;
	}

	return 0;
}
```
