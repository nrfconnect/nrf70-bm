## CMakeLists.txt
```
#
# Copyright (c) 2022 Nordic Semiconductor ASA
#
# SPDX-License-Identifier: LicenseRef-Nordic-5-Clause
#

cmake_minimum_required(VERSION 3.20.0)

find_package(Zephyr REQUIRED HINTS $ENV{ZEPHYR_BASE})
project(nrf_wifi_radio_test)

set(NRF_WIFI_DIR ${ZEPHYR_NRF_WIFI_MODULE_DIR})
set(NRF70_BM_DIR ../../nrf70_bm_lib)
set(NRF70_SHIM_DIR ../../nrf70_zephyr_shim)

target_compile_definitions(app PRIVATE
	-DCONFIG_NRF70_BM_RADIO_TEST
	-DNRF70_RADIO_TEST # OSAL
)

target_include_directories(app PRIVATE
	inc
	${NRF70_BM_DIR}/include
	${NRF_WIFI_DIR}/utils/inc
	${NRF_WIFI_DIR}/os_if/inc
	${NRF_WIFI_DIR}/bus_if/bus/qspi/inc
	${NRF_WIFI_DIR}/bus_if/bal/inc
	${NRF_WIFI_DIR}/fw_if/umac_if/inc
	${NRF_WIFI_DIR}/fw_load/mips/fw/inc
	${NRF_WIFI_DIR}/hw_if/hal/inc
	${NRF_WIFI_DIR}/hw_if/hal/inc/fw
	${NRF_WIFI_DIR}/fw_if/umac_if/inc/fw
	${NRF_WIFI_DIR}/fw_if/umac_if/inc/radio_test
	${NRF70_SHIM_DIR}/include
)

target_sources(app PRIVATE
	src/nrf_wifi_radio_test_main.c
	src/nrf_wifi_radio_test_shell.c
	src/nrf_wifi_radio_ficr_shell.c
	src/nrf_wifi_ficr_prog.c
)

target_link_libraries(app PRIVATE nrf70-bm-lib)
```

## Kconfig
```
#
# Copyright (c) 2024 Nordic Semiconductor
#
# SPDX-License-Identifier: LicenseRef-Nordic-5-Clause
#
source "Kconfig.zephyr"

menu "Nordic radio test sample"

config ZEPHYR_SHELL
  bool "Zephyr shell support"
  default y
  select SHELL_BACKEND
  select SHELL_BACKEND_SERIAL

endmenu

config WIFI_RT_REG_DOMAIN
	string "Regulatory domain"
	default "00"
	help
	  Specifies the regulatory domain to be used for the radio test.
```

## sample.yaml
```
sample:
  description: Wi-Fi radio test sample
    application
  name: Wi-Fi radio test
tests:
  sample.nrf7002.radio_test:
    sysbuild: true
    build_only: true
    integration_platforms:
      - nrf7002dk/nrf5340/cpuapp
    platform_allow: nrf7002dk/nrf5340/cpuapp
    tags: ci_build sysbuild
  sample.nrf7001.radio_test:
    sysbuild: true
    build_only: true
    integration_platforms:
      - nrf7002dk/nrf5340/cpuapp/nrf7001
    platform_allow: nrf7002dk/nrf5340/cpuapp/nrf7001
    tags: ci_build sysbuild
    skip: true
  sample.nrf7002.radio_test_combo:
    sysbuild: true
    build_only: true
    extra_args: CONFIG_NRF70_RADIO_TEST_COMBO=y
    integration_platforms:
      - nrf7002dk/nrf5340/cpuapp
    platform_allow: nrf7002dk/nrf5340/cpuapp
    tags: ci_build sysbuild
  sample.nrf7002_eks.radio_test:
    sysbuild: true
    build_only: true
    extra_args: SHIELD=nrf7002ek
    integration_platforms:
      - nrf5340dk/nrf5340/cpuapp
      - nrf52840dk/nrf52840
    platform_allow: nrf5340dk/nrf5340/cpuapp nrf52840dk/nrf52840
    tags: ci_build sysbuild
  sample.nrf7001_eks.radio_test:
    sysbuild: true
    build_only: true
    extra_args: SHIELD=nrf7002ek_nrf7001
    integration_platforms:
      - nrf5340dk/nrf5340/cpuapp
      - nrf52840dk/nrf52840
    platform_allow: nrf5340dk/nrf5340/cpuapp nrf52840dk/nrf52840
    tags: ci_build sysbuild
  sample.nrf7000_eks.radio_test:
    sysbuild: true
    build_only: true
    extra_args: SHIELD=nrf7002ek_nrf7000
    integration_platforms:
      - nrf9160dk/nrf9160/ns
    platform_allow: nrf9160dk/nrf9160/ns
    tags: ci_build sysbuild
  sample.nrf7002_eb.thingy53.radio_test:
    sysbuild: true
    build_only: true
    extra_args: radio_test_SHIELD=nrf7002eb
    integration_platforms:
      - thingy53/nrf5340/cpuapp
    platform_allow: thingy53/nrf5340/cpuapp
    tags: ci_build sysbuild
  sample.thingy91x_nrf7002.radio_test:
    sysbuild: true
    build_only: true
    platform_allow: thingy91x/nrf9151/ns
    tags: ci_build sysbuild
```

## sysbuild.conf
```
#
# Copyright (c) 2024 Nordic Semiconductor ASA
#
# SPDX-License-Identifier: LicenseRef-Nordic-5-Clause
#

SB_CONFIG_WIFI_NRF700X=y
SB_CONFIG_WIFI_NRF70_RADIO_TEST=y
```

## prj.conf
```kconfig
#
# Copyright (c) 2024 Nordic Semiconductor ASA
#
# SPDX-License-Identifier: BSD-3-Clause
#

CONFIG_NRF70_BM_LIB=y
CONFIG_NRF70_RADIO_TEST=y
CONFIG_MAIN_STACK_SIZE=4200
CONFIG_SHELL_STACK_SIZE=4200
#64K memory needed for IQ sample captures.
CONFIG_HEAP_MEM_POOL_SIZE=98304

# Shell
CONFIG_SHELL=y
CONFIG_SHELL_BACKEND_SERIAL=y

# Debugs
CONFIG_THREAD_MONITOR=y
CONFIG_LOG=y
# For automation scripts only
CONFIG_SHELL_BACKEND_SERIAL_RX_RING_BUFFER_SIZE=1024
CONFIG_LOG=y
CONFIG_LOG_MODE_IMMEDIATE=y
```

## inc/nrf_wifi_radio_test_shell.h
```c
/*
 * Copyright (c) 2022 Nordic Semiconductor ASA
 *
 * SPDX-License-Identifier: LicenseRef-Nordic-5-Clause
 */

/* @file
 * @brief nRF Wi-Fi radio-test mode shell module
 */
#ifndef NRF_WIFI_RADIO_TEST_SHELL_H__
#define NRF_WIFI_RADIO_TEST_SHELL_H__
#include <zephyr/kernel.h>
#include <stdio.h>
#include <stdlib.h>
#include <zephyr/init.h>
#include <ctype.h>
#include <host_rpu_sys_if.h>
#include <radio_test/phy_rf_params.h>
#include <fmac_structs.h>

#include <radio_test/nrf70_bm_core.h>

#define NRF_WIFI_RADIO_TEST_INIT_TIMEOUT_MS 5000
#ifdef CONFIG_ZEPHYR_SHELL
#include <shell/shell.h>
#include <shell/shell_uart.h>

extern struct shell *shell_global;

#define RT_SHELL_PRINTF_INFO(fmt, ...)                                         \
	do {                                                                         \
		if (shell_global) {                                                        \
			shell_fprintf(shell_global, SHELL_INFO, fmt, ##__VA_ARGS__);             \
		} else {                                                                   \
			printf(fmt, ##__VA_ARGS__);                                              \
		}                                                                          \
	} while (0)

#define RT_SHELL_PRINTF_ERROR(fmt, ...)                                        \
	do {                                                                         \
		if (shell_global) {                                                        \
			shell_fprintf(shell_global, SHELL_ERROR, fmt, ##__VA_ARGS__);            \
		} else {                                                                   \
			printf(fmt, ##__VA_ARGS__);                                              \
		}                                                                          \
	} while (0)

#define RT_SHELL_PRINTF_WARNING(fmt, ...)                                      \
	do {                                                                         \
		if (shell_global) {                                                        \
			shell_fprintf(shell_global, SHELL_WARNING, fmt, ##__VA_ARGS__);          \
		} else {                                                                   \
			printf(fmt, ##__VA_ARGS__);                                              \
		}                                                                          \
	} while (0)

#define DEFINE_CMD_HANDLER(name)                                               \
  static int name##_sh(const struct shell *sh, size_t argc, const char *argv[]) {           \
    shell_global = (struct shell *)sh;                                         \
    return name(argc, argv);                                                   \
  }

#define RTSH(fn) fn##_sh

#else
#define RT_SHELL_PRINTF_INFO(fmt, ...) printf(fmt, ##__VA_ARGS__)

#define RT_SHELL_PRINTF_ERROR(fmt, ...) printf(fmt, ##__VA_ARGS__)

#define RT_SHELL_PRINTF_WARNING(fmt, ...) printf(fmt, ##__VA_ARGS__)

#define DEFINE_CMD_HANDLER(name)
#endif

struct nrf_wifi_ctx_zep_rt {
	struct nrf_wifi_fmac_priv *fmac_priv;
	struct rpu_conf_params conf_params;
};

int nrf_wifi_radio_test_shell_init(void);

#endif /* NRF_WIFI_RADIO_TEST_SHELL_H__ */
```

## src/nrf_wifi_ficr_prog.c
```c
/*
 * Copyright (c) 2022 Nordic Semiconductor ASA
 *
 * SPDX-License-Identifier: LicenseRef-Nordic-5-Clause
 */

/* @file
 * @brief NRF Wi-Fi radio FICR programming functions
 */

#include <zephyr/logging/log.h>
#include <zephyr/kernel.h>
#include "common/rpu_if.h"
#include "rpu_hw_if.h"
#include "nrf_wifi_ficr_prog.h"


LOG_MODULE_REGISTER(otp_prog, CONFIG_WIFI_NRF70_SHIM_BUS_LOG_LEVEL);

static void write_word(unsigned int addr, unsigned int data)
{
	rpu_write(addr, &data, 4);
}

static void read_word(unsigned int addr, unsigned int *data)
{
	rpu_read(addr, data, 4);
}

unsigned int check_protection(unsigned int *buff, unsigned int off1, unsigned int off2,
		    unsigned int off3, unsigned int off4)
{
	if ((buff[off1] == OTP_PROGRAMMED) &&
		(buff[off2] == OTP_PROGRAMMED)  &&
		(buff[off3] == OTP_PROGRAMMED) &&
		(buff[off4] == OTP_PROGRAMMED))
		return OTP_PROGRAMMED;
	else if ((buff[off1] == OTP_FRESH_FROM_FAB) &&
		(buff[off2] == OTP_FRESH_FROM_FAB) &&
		(buff[off3] == OTP_FRESH_FROM_FAB) &&
		(buff[off4] == OTP_FRESH_FROM_FAB))
		return OTP_FRESH_FROM_FAB;
	else if ((buff[off1] == OTP_ENABLE_PATTERN) &&
		(buff[off2] == OTP_ENABLE_PATTERN) &&
		(buff[off3] == OTP_ENABLE_PATTERN) &&
		(buff[off4] == OTP_ENABLE_PATTERN))
		return OTP_ENABLE_PATTERN;
	else
		return OTP_INVALID;
}


static void set_otp_timing_reg_40mhz(void)
{
	write_word(OTP_TIMING_REG1_ADDR, OTP_TIMING_REG1_VAL);
	write_word(OTP_TIMING_REG2_ADDR, OTP_TIMING_REG2_VAL);
}

static int poll_otp_ready(void)
{
	int otp_mem_status = 0;
	int poll = 0;

	while (poll != 100) {
		read_word(OTP_POLL_ADDR, &otp_mem_status);

		if ((otp_mem_status & OTP_READY) == OTP_READY) {
			return 0;
		}
		poll++;
	}
	LOG_ERR("OTP is not ready");
	return -ENOEXEC;
}


static int req_otp_standby_mode(void)
{
	write_word(OTP_RWSBMODE_ADDR, 0x0);
	return poll_otp_ready();
}


static int otp_wr_voltage_2V5(void)
{
	int err;

	err = req_otp_standby_mode();

	if (err) {
		LOG_ERR("Failed Setting OTP voltage IOVDD to 2.5V");
		return -ENOEXEC;
	}
	write_word(OTP_VOLTCTRL_ADDR, OTP_VOLTCTRL_2V5);
	return 0;
}

static int poll_otp_read_valid(void)
{
	int otp_mem_status = 0;
	int poll = 0;

	while (poll < 100) {
		read_word(OTP_POLL_ADDR, &otp_mem_status);

		if ((otp_mem_status & OTP_READ_VALID) == OTP_READ_VALID) {
			return 0;
		}
		poll++;
	}
	LOG_ERR("failed poll_otp_read_valid()");
	return -ENOEXEC;
}

static int poll_otp_wrdone(void)
{
	int otp_mem_status = 0;
	int poll = 0;

	while (poll < 100) {
		read_word(OTP_POLL_ADDR, &otp_mem_status);

		if ((otp_mem_status & OTP_WR_DONE) == OTP_WR_DONE) {
			return 0;
		}
		poll++;
	}
	LOG_ERR("failed poll_otp_wrdone()");
	return -ENOEXEC;
}

static int req_otp_read_mode(void)
{
	write_word(OTP_RWSBMODE_ADDR, OTP_READ_MODE);
	return poll_otp_ready();
}


static int req_otp_byte_write_mode(void)
{
	write_word(OTP_RWSBMODE_ADDR, OTP_BYTE_WRITE_MODE);
	return poll_otp_ready();
}

static unsigned int read_otp_location(unsigned int offset, unsigned int *read_val)
{
	int err;

	write_word(OTP_RDENABLE_ADDR,  offset);
	err = poll_otp_read_valid();
	if (err) {
		LOG_ERR("OTP read failed");
		return err;
	}
	read_word(OTP_READREG_ADDR, read_val);

	return 0;
}

static int  write_otp_location(unsigned int otp_location_offset, unsigned int otp_data)
{
	write_word(OTP_WRENABLE_ADDR,  otp_location_offset);
	write_word(OTP_WRITEREG_ADDR,  otp_data);

	return poll_otp_wrdone();
}


static int otp_rd_voltage_1V8(void)
{
	int err;

	err = req_otp_standby_mode();
	if (err) {
		LOG_ERR("error in %s", __func__);
		return err;
	}
	write_word(OTP_VOLTCTRL_ADDR, OTP_VOLTCTRL_1V8);

	return 0;
}

static int update_mac_addr(unsigned int index, unsigned int *write_val)
{
	int ret = 0;

	for (int i = 0; i < 2; i++) {
		ret = write_otp_location(MAC0_ADDR + 2 * index + i, write_val[i]);
		if (ret == -ENOEXEC) {
			LOG_ERR("FICR: Failed to update MAC ADDR%d", index);
			break;
		}
		LOG_INF("mac addr %d : Reg%d (0x%x) = 0x%04x",
					index, (i+1), (MAC0_ADDR + i) << 2, write_val[i]);
	}
	return ret;
}

int write_otp_memory(unsigned int otp_addr, unsigned int *write_val)
{
	int err = 0;
	int	mask_val;
	int ret = 0;
	int retrim_loc = 0;

	err = poll_otp_ready();
	if (err) {
		LOG_ERR("err in otp ready poll");
		return err;
	}

	set_otp_timing_reg_40mhz();

	err = otp_wr_voltage_2V5();
	if (err) {
		LOG_ERR("error in write_voltage 2V5");
		goto _exit_otp_write;
	}

	err = req_otp_byte_write_mode();
	if (err) {
		LOG_ERR("error in OTP byte write mode");
		goto _exit_otp_write;
	}

	switch (otp_addr) {
	case REGION_PROTECT:
		write_otp_location(REGION_PROTECT, write_val[0]);
		write_otp_location(REGION_PROTECT+1, write_val[0]);
		write_otp_location(REGION_PROTECT+2, write_val[0]);
		write_otp_location(REGION_PROTECT+3, write_val[0]);

		LOG_INF("Written REGION_PROTECT0 (0x%x) : 0x%04x",
						(REGION_PROTECT << 2), write_val[0]);
		LOG_INF("Written REGION_PROTECT1 (0x%x) : 0x%04x",
						(REGION_PROTECT+1) << 2, write_val[0]);
		LOG_INF("Written REGION_PROTECT2 (0x%x) : 0x%04x",
						(REGION_PROTECT+2) << 2, write_val[0]);
		LOG_INF("Written REGION_PROTECT3 (0x%x) : 0x%04x",
						(REGION_PROTECT+3) << 2, write_val[0]);
		break;
	case QSPI_KEY:
		mask_val = QSPI_KEY_FLAG_MASK;
		for (int i = 0; i < QSPI_KEY_LENGTH_BYTES / 4; i++) {
			ret = write_otp_location(QSPI_KEY + i, write_val[i]);
			if (ret == -ENOEXEC) {
				LOG_ERR("FICR: Failed to write QSPI key offset-%d", QSPI_KEY + i);
				goto _exit_otp_write;
			}
			LOG_INF("Written QSPI_KEY0 (0x%x) : 0x%04x",
						(QSPI_KEY + i) << 2, write_val[i]);
		}
		write_otp_location(REGION_DEFAULTS, mask_val);
		LOG_INF("Written REGION_DEFAULTS (0x%x) : 0x%04x",
						(REGION_DEFAULTS) << 2, mask_val);
		break;
	case MAC0_ADDR:
		mask_val = MAC0_ADDR_FLAG_MASK;
		ret = update_mac_addr(0, write_val);
		if (ret == -ENOEXEC) {
			goto _exit_otp_write;
		}

		write_otp_location(REGION_DEFAULTS, mask_val);
		LOG_INF("Written MAC address 0");
		LOG_INF("Written REGION_DEFAULTS (0x%x) : 0x%04x",
						(REGION_DEFAULTS) << 2, mask_val);
		break;
	case MAC1_ADDR:
		mask_val = MAC1_ADDR_FLAG_MASK;
		ret = update_mac_addr(1, write_val);
		if (ret == -ENOEXEC) {
			goto _exit_otp_write;
		}
		write_otp_location(REGION_DEFAULTS, mask_val);
		LOG_INF("Written MAC address 1");
		LOG_INF("Written REGION_DEFAULTS (0x%x) : 0x%04x",
						(REGION_DEFAULTS) << 2, mask_val);
		break;
	case CALIB_XO:
		mask_val = CALIB_XO_FLAG_MASK;
		ret = write_otp_location(CALIB_XO, write_val[0]);

		if (ret == -ENOEXEC) {
			LOG_ERR("XO_Update Exception");
			goto _exit_otp_write;
		} else {
			write_otp_location(REGION_DEFAULTS, mask_val);

			LOG_INF("Written CALIB_XO (0x%x) to 0x%04x",
						CALIB_XO << 2, write_val[0]);
			LOG_INF("Written REGION_DEFAULTS (0x%x) : 0x%04x",
						(REGION_DEFAULTS) << 2, mask_val);
		}
		break;
	case PRODRETEST_PROGVERSION:
		ret = write_otp_location(PRODRETEST_PROGVERSION, *write_val);

		if (ret == -ENOEXEC) {
			LOG_ERR("PRODRETEST.PROGVERSION_Update Exception");
			goto _exit_otp_write;
		} else {
			LOG_INF("Written PRODRETEST.PROGVERSION 0x%04x", *write_val);
		}
		break;
	case PRODRETEST_TRIM0:
	case PRODRETEST_TRIM1:
	case PRODRETEST_TRIM2:
	case PRODRETEST_TRIM3:
	case PRODRETEST_TRIM4:
	case PRODRETEST_TRIM5:
	case PRODRETEST_TRIM6:
	case PRODRETEST_TRIM7:
	case PRODRETEST_TRIM8:
	case PRODRETEST_TRIM9:
	case PRODRETEST_TRIM10:
	case PRODRETEST_TRIM11:
	case PRODRETEST_TRIM12:
	case PRODRETEST_TRIM13:
	case PRODRETEST_TRIM14:
		retrim_loc = otp_addr - PRODRETEST_TRIM0;
		ret = write_otp_location(otp_addr, *write_val);

		if (ret == -ENOEXEC) {
			LOG_ERR("PRODRETEST.TRIM_Update Exception");
			goto _exit_otp_write;
		} else {
			LOG_INF("Written PRODRETEST.TRIM%d 0x%04x",
						retrim_loc, *write_val);
		}
		break;
	case REGION_DEFAULTS:
		write_otp_location(REGION_DEFAULTS, write_val[0]);

		LOG_INF("Written REGION_DEFAULTS (0x%x) to 0x%04x",
						REGION_DEFAULTS << 2, write_val[0]);
		break;
	default:
		LOG_ERR("unknown field received: %d", otp_addr);

	}
	return ret;

_exit_otp_write:
	err  = req_otp_standby_mode();
	err |= otp_rd_voltage_1V8();
	return err;
}

int read_otp_memory(unsigned int otp_addr, unsigned int *read_val, int len)
{
	int	err;

	err = poll_otp_ready();
	if (err) {
		LOG_ERR("err in otp ready poll");
		return -ENOEXEC;
	}

	set_otp_timing_reg_40mhz();

	err = otp_rd_voltage_1V8();
	if (err) {
		LOG_ERR("error in read_voltage 1V8");
		return -ENOEXEC;
	}

	err = req_otp_read_mode();
	if (err) {
		LOG_ERR("error in req_otp_read_mode()");
		return -ENOEXEC;
	}

	for (int i = 0; i < len; i++) {
		read_otp_location(otp_addr + i, &read_val[i]);
	}

	return req_otp_standby_mode();
}
```

## src/nrf_wifi_radio_ficr_shell.c
```c
/*
 * Copyright (c) 2022 Nordic Semiconductor ASA
 *
 * SPDX-License-Identifier: LicenseRef-Nordic-5-Clause
 */

/* @file
 * @brief NRF Wi-Fi radio test shell module
 */

#include <nrf_wifi_radio_test_shell.h>
#include <util.h>
#include <radio_test/nrf70_bm_core.h>

#include "nrf_wifi_ficr_prog.h"
#include "common/fmac_api_common.h"

extern struct nrf70_bm_rt_wifi_drv_priv nrf70_bm_priv;
static struct nrf70_bm_rt_wifi_ctx *ctx = &nrf70_bm_priv.rpu_ctx_bm;

static void disp_location_status(char *region, unsigned int ret) {
  switch (ret) {

  case OTP_PROGRAMMED:
    RT_SHELL_PRINTF_INFO("%s Region is locked!!!\n", region);
    break;
  case OTP_ENABLE_PATTERN:
    RT_SHELL_PRINTF_INFO("%s Region is open for R/W\n", region);
    break;
  case OTP_FRESH_FROM_FAB:
    RT_SHELL_PRINTF_INFO("%s Region is unprogrammed - program to enable R/W\n",
                         region);
    break;
  default:
    RT_SHELL_PRINTF_ERROR("%s Region is in invalid state\n", region);
    break;
  }
  RT_SHELL_PRINTF_INFO("\n");
}

static void disp_fields_status(unsigned int flags) {
  if (flags & (~QSPI_KEY_FLAG_MASK)) {
    RT_SHELL_PRINTF_INFO("QSPI Keys are not programmed in OTP\n");
  } else {
    RT_SHELL_PRINTF_INFO("QSPI Keys are programmed in OTP\n");
  }

  if (flags & (~MAC0_ADDR_FLAG_MASK)) {
    RT_SHELL_PRINTF_INFO("MAC0 Address are not programmed in OTP\n");
  } else {
    RT_SHELL_PRINTF_INFO("MAC0 Address is programmed in OTP\n");
  }

  if (flags & (~MAC1_ADDR_FLAG_MASK)) {
    RT_SHELL_PRINTF_INFO("MAC1 Address are not programmed in OTP\n");
  } else {
    RT_SHELL_PRINTF_INFO("MAC1 Address is programmed in OTP\n");
  }

  if (flags & (~CALIB_XO_FLAG_MASK)) {
    RT_SHELL_PRINTF_INFO("CALIB_XO is not programmed in OTP\n");
  } else {
    RT_SHELL_PRINTF_INFO("CALIB_XO is programmed in OTP\n");
  }
}

static int nrf_wifi_radio_test_otp_get_status(size_t argc, const char *argv[]) {
  unsigned int ret, err;
  unsigned int val[OTP_MAX_WORD_LEN];

  /* read all the OTP memory */
  err = read_otp_memory(0, &val[0], OTP_MAX_WORD_LEN);
  if (err) {
    RT_SHELL_PRINTF_ERROR("FAILED reading otp memory......\n");
    return -ENOEXEC;
  }

  RT_SHELL_PRINTF_INFO("Checking OTP PROTECT Region......\n");
  ret = check_protection(&val[0], REGION_PROTECT, REGION_PROTECT + 1,
                         REGION_PROTECT + 2, REGION_PROTECT + 3);

  disp_location_status("OTP", ret);
  disp_fields_status(val[REGION_DEFAULTS]);

  return 0;
}

static int nrf_wifi_radio_test_otp_read_params(size_t argc, const char *argv[]) {
  unsigned int val[OTP_MAX_WORD_LEN];
  unsigned int ret, err;

  err = read_otp_memory(0, &val[0], OTP_MAX_WORD_LEN);
  if (err) {
    RT_SHELL_PRINTF_ERROR("FAILED reading otp memory......\n");
    return -ENOEXEC;
  }

  ret = check_protection(&val[0], REGION_PROTECT + 0, REGION_PROTECT + 1,
                         REGION_PROTECT + 2, REGION_PROTECT + 3);
  disp_location_status("OTP", ret);

  RT_SHELL_PRINTF_INFO("PRODTEST.FT.PROGVERSION = 0x%08x\n",
                       val[PRODTEST_FT_PROGVERSION]);
  RT_SHELL_PRINTF_INFO("\n");

  RT_SHELL_PRINTF_INFO("PRODTEST.TRIM0 = 0x%08x\n", val[PRODTEST_TRIM0]);
  RT_SHELL_PRINTF_INFO("PRODTEST.TRIM1 = 0x%08x\n", val[PRODTEST_TRIM1]);
  RT_SHELL_PRINTF_INFO("PRODTEST.TRIM2 = 0x%08x\n", val[PRODTEST_TRIM2]);
  RT_SHELL_PRINTF_INFO("PRODTEST.TRIM3 = 0x%08x\n", val[PRODTEST_TRIM3]);
  RT_SHELL_PRINTF_INFO("PRODTEST.TRIM4 = 0x%08x\n", val[PRODTEST_TRIM4]);
  RT_SHELL_PRINTF_INFO("PRODTEST.TRIM5 = 0x%08x\n", val[PRODTEST_TRIM5]);
  RT_SHELL_PRINTF_INFO("PRODTEST.TRIM6 = 0x%08x\n", val[PRODTEST_TRIM6]);
  RT_SHELL_PRINTF_INFO("PRODTEST.TRIM7 = 0x%08x\n", val[PRODTEST_TRIM7]);
  RT_SHELL_PRINTF_INFO("PRODTEST.TRIM8 = 0x%08x\n", val[PRODTEST_TRIM8]);
  RT_SHELL_PRINTF_INFO("PRODTEST.TRIM9 = 0x%08x\n", val[PRODTEST_TRIM9]);
  RT_SHELL_PRINTF_INFO("PRODTEST.TRIM10 = 0x%08x\n", val[PRODTEST_TRIM10]);
  RT_SHELL_PRINTF_INFO("PRODTEST.TRIM11 = 0x%08x\n", val[PRODTEST_TRIM11]);
  RT_SHELL_PRINTF_INFO("PRODTEST.TRIM12 = 0x%08x\n", val[PRODTEST_TRIM12]);
  RT_SHELL_PRINTF_INFO("PRODTEST.TRIM13 = 0x%08x\n", val[PRODTEST_TRIM13]);
  RT_SHELL_PRINTF_INFO("PRODTEST.TRIM14 = 0x%08x\n", val[PRODTEST_TRIM14]);
  RT_SHELL_PRINTF_INFO("\n");

  RT_SHELL_PRINTF_INFO("INFO.PART = 0x%08x\n", val[INFO_PART]);
  RT_SHELL_PRINTF_INFO("INFO.VARIANT = 0x%08x\n", val[INFO_VARIANT]);
  RT_SHELL_PRINTF_INFO("\n");

  RT_SHELL_PRINTF_INFO("INFO.UUID0 = 0x%08x\n", val[INFO_UUID + 0]);
  RT_SHELL_PRINTF_INFO("INFO.UUID1 = 0x%08x\n", val[INFO_UUID + 1]);
  RT_SHELL_PRINTF_INFO("INFO.UUID2 = 0x%08x\n", val[INFO_UUID + 2]);
  RT_SHELL_PRINTF_INFO("INFO.UUID3 = 0x%08x\n", val[INFO_UUID + 3]);
  RT_SHELL_PRINTF_INFO("\n");

  RT_SHELL_PRINTF_INFO("REGION.PROTECT0 = 0x%08x\n", val[REGION_PROTECT + 0]);
  RT_SHELL_PRINTF_INFO("REGION.PROTECT1 = 0x%08x\n", val[REGION_PROTECT + 1]);
  RT_SHELL_PRINTF_INFO("REGION.PROTECT2 = 0x%08x\n", val[REGION_PROTECT + 2]);
  RT_SHELL_PRINTF_INFO("REGION.PROTECT3 = 0x%08x\n", val[REGION_PROTECT + 3]);
  RT_SHELL_PRINTF_INFO("\n");

  if (val[REGION_PROTECT + 0] != OTP_FRESH_FROM_FAB) {
    RT_SHELL_PRINTF_INFO("MAC0.ADDRESS0 = 0x%08x\n", val[MAC0_ADDR]);
    RT_SHELL_PRINTF_INFO("MAC0.ADDRESS1 = 0x%08x\n", val[MAC0_ADDR + 1]);
    RT_SHELL_PRINTF_INFO(
        "MAC0.ADDRESS = %02x:%02x:%02x:%02x:%02x:%02x\n",
        (uint8_t)(val[MAC0_ADDR]), (uint8_t)(val[MAC0_ADDR] >> 8),
        (uint8_t)(val[MAC0_ADDR] >> 16), (uint8_t)(val[MAC0_ADDR] >> 24),
        (uint8_t)(val[MAC0_ADDR + 1]), (uint8_t)(val[MAC0_ADDR + 1] >> 8));
    RT_SHELL_PRINTF_INFO("\n");

    RT_SHELL_PRINTF_INFO("MAC1.ADDRESS0 = 0x%08x\n", val[MAC1_ADDR]);
    RT_SHELL_PRINTF_INFO("MAC1.ADDRESS1 = 0x%08x\n", val[MAC1_ADDR + 1]);
    RT_SHELL_PRINTF_INFO(
        "MAC1.ADDRESS = %02x:%02x:%02x:%02x:%02x:%02x\n",
        (uint8_t)(val[MAC1_ADDR]), (uint8_t)(val[MAC1_ADDR] >> 8),
        (uint8_t)(val[MAC1_ADDR] >> 16), (uint8_t)(val[MAC1_ADDR] >> 24),
        (uint8_t)(val[MAC1_ADDR + 1]), (uint8_t)(val[MAC1_ADDR + 1] >> 8));
    RT_SHELL_PRINTF_INFO("\n");

    RT_SHELL_PRINTF_INFO("CALIB.XO = 0x%02x\n", val[CALIB_XO] & 0xFF);

    RT_SHELL_PRINTF_INFO("REGION_DEFAULTS = 0x%08x\n", val[REGION_DEFAULTS]);
    RT_SHELL_PRINTF_INFO("\n");
  }
  return 0;
}

static int nrf_wifi_radio_test_otp_read_retrim_version(size_t argc,
                                                       const char *argv[]) {
  unsigned int val[1];
  unsigned int err;

  err = read_otp_memory(REGION_PROTECT, &val[0], 1);
  if (err) {
    RT_SHELL_PRINTF_ERROR("FAILED reading otp memory......\n");
    return -ENOEXEC;
  }

  if (val[0] == OTP_FRESH_FROM_FAB) {
    RT_SHELL_PRINTF_ERROR("Region is unprogrammed - program to enable R/W\n");
  } else {
    err = read_otp_memory(PRODRETEST_PROGVERSION, &val[0], 1);
    RT_SHELL_PRINTF_INFO("\nPRODRETEST.PROGVERSION = 0x%08x\n", val[0]);
    RT_SHELL_PRINTF_INFO("\n");
  }
  return 0;
}

static int nrf_wifi_radio_test_otp_read_retrim_params(size_t argc,
                                                      const char *argv[]) {
  unsigned int val[RETRIM_LEN];
  unsigned int err;

  err = read_otp_memory(REGION_PROTECT, val, 1);
  if (err) {
    RT_SHELL_PRINTF_ERROR("FAILED reading otp memory......\n");
    return -ENOEXEC;
  }

  if (val[0] == OTP_FRESH_FROM_FAB) {
    RT_SHELL_PRINTF_ERROR("Region is unprogrammed - program to enable R/W\n");
  } else {
    RT_SHELL_PRINTF_INFO("\n");
    err = read_otp_memory(PRODRETEST_TRIM0, val, RETRIM_LEN);
    for (int i = 0; i < RETRIM_LEN; i++) {
      RT_SHELL_PRINTF_INFO("PRODRETEST.TRIM%d = 0x%08x\n", i, val[i]);
    }
    RT_SHELL_PRINTF_INFO("\n");
  }

  return 0;
}

static int nrf_wifi_radio_test_otp_write_params(size_t argc, const char *argv[]) {
  unsigned int field;
  unsigned int write_val[20];
  unsigned int val[OTP_MAX_WORD_LEN];
  unsigned int ret, err;
  int status = 0;

  if (argc < 2) {
    RT_SHELL_PRINTF_ERROR("invalid # of args : %d\n", argc);
    return -ENOEXEC;
  }

  field = strtoul(argv[1], NULL, 0);
  /* Align to 32-bit word address */
  field >>= 2;

  if (field < REGION_PROTECT) {
    RT_SHELL_PRINTF_ERROR("INVALID Address 0x%x......\n", field << 2);
    return -ENOEXEC;
  }

  if ((field >= PRODRETEST_PROGVERSION) && (field <= PRODRETEST_TRIM14)) {
    RT_SHELL_PRINTF_ERROR("INVALID Address 0x%x......\n", field << 2);
    return -ENOEXEC;
  }

  err = read_otp_memory(REGION_PROTECT, &val[REGION_PROTECT], 4);
  if (err) {
    RT_SHELL_PRINTF_ERROR("FAILED reading otp memory......\n");
    return -ENOEXEC;
  }

  ret = check_protection(&val[0], REGION_PROTECT, REGION_PROTECT + 1,
                         REGION_PROTECT + 2, REGION_PROTECT + 3);
  disp_location_status("OTP", ret);
  if (ret != OTP_ENABLE_PATTERN && ret != OTP_FRESH_FROM_FAB) {
    RT_SHELL_PRINTF_ERROR("USER Region is not Writeable\n");
    return -ENOEXEC;
  }

  switch (field) {
  case REGION_PROTECT:
    if (argc != 3) {
      RT_SHELL_PRINTF_ERROR(
          "invalid # of args for REGION_PROTECT (expected 3) : %d\n", argc);
      return -ENOEXEC;
    }
    write_val[0] = strtoul(argv[2], NULL, 0);
    /* All consecutive 4 words of the REGION_PROTECT are written */
    write_otp_memory(REGION_PROTECT, &write_val[0]);
    break;
  case MAC0_ADDR:
  case MAC1_ADDR:
    struct nrf_wifi_fmac_dev_ctx *fmac_dev_ctx = ctx->rpu_ctx;

    if (!fmac_dev_ctx) {
      RT_SHELL_PRINTF_ERROR("Driver not initialized\n");
      return -ENOEXEC;
    }

    if (argc != 4) {
      RT_SHELL_PRINTF_ERROR(
          "invalid # of args for MAC ADDR write (expected 4) : %d\n", argc);
      return -ENOEXEC;
    }
    write_val[0] = strtoul(argv[2], NULL, 0);
    write_val[1] = strtoul(argv[3], NULL, 0) & 0xFFFF;

    if (!nrf_wifi_utils_is_mac_addr_valid((const char *)&write_val[0])) {
      RT_SHELL_PRINTF_ERROR("Invalid MAC address. MAC address cannot be all "
                            "0's, broadcast or multicast address\n");
      return -ENOEXEC;
    }

    status = write_otp_memory(field, &write_val[0]);
    break;
  case CALIB_XO:
  case REGION_DEFAULTS:
    if (argc != 3) {
      RT_SHELL_PRINTF_ERROR(
          "invalid # of args for field %d (expected 3) : %d\n", field, argc);
      return -ENOEXEC;
    }
    write_val[0] = strtoul(argv[2], NULL, 0);
    status = write_otp_memory(field, &write_val[0]);
    break;
  case QSPI_KEY:
    if (argc != 6) {
      RT_SHELL_PRINTF_ERROR(
          "invalid # of args for QSPI_KEY (expected 6) : %d\n", argc);
      return -ENOEXEC;
    }
    write_val[0] = strtoul(argv[2], NULL, 0);
    write_val[1] = strtoul(argv[3], NULL, 0);
    write_val[2] = strtoul(argv[4], NULL, 0);
    write_val[3] = strtoul(argv[5], NULL, 0);
    /* All consecutive 4 words of the qspi keys are written now */
    status = write_otp_memory(QSPI_KEY, &write_val[0]);
    break;
  default:
    RT_SHELL_PRINTF_ERROR("unsupported field %d\n", field);
    return -ENOEXEC;
  }

  if (!status) {
    RT_SHELL_PRINTF_INFO("Finished Writing OTP params\n");
  }

  return 0;
}

static int nrf_wifi_radio_test_otp_write_retrim_version(size_t argc,
                                                        const char *argv[]) {
  unsigned int field;
  unsigned int write_val;
  unsigned int val[OTP_MAX_WORD_LEN];
  unsigned int ret, err;
  int status = 0;

  field = PRODRETEST_PROGVERSION;

  if (argc != 2) {
    RT_SHELL_PRINTF_ERROR("invalid # of args for field %d (expected 2) : %d\n",
                          field, argc);
    return -ENOEXEC;
  }

  err = read_otp_memory(REGION_PROTECT, &val[REGION_PROTECT], 4);
  if (err) {
    RT_SHELL_PRINTF_ERROR("FAILED reading otp memory......\n");
    return -ENOEXEC;
  }

  ret = check_protection(&val[0], REGION_PROTECT, REGION_PROTECT + 1,
                         REGION_PROTECT + 2, REGION_PROTECT + 3);
  disp_location_status("OTP", ret);
  if (ret != OTP_ENABLE_PATTERN && ret != OTP_FRESH_FROM_FAB) {
    RT_SHELL_PRINTF_ERROR("USER Region is not Writeable\n");
    return -ENOEXEC;
  }

  write_val = strtoul(argv[1], NULL, 0);
  status = write_otp_memory(field, &write_val);

  if (!status) {
    RT_SHELL_PRINTF_INFO("Finished Writing Retrim version\n");
  }

  return 0;
}

static int nrf_wifi_radio_test_otp_write_retrim_params(size_t argc,
                                                       const char *argv[]) {
  unsigned int index;
  unsigned int field;
  unsigned int write_val;
  unsigned int val[OTP_MAX_WORD_LEN];
  unsigned int ret, err;
  int status = 0;

  index = strtoul(argv[1], NULL, 0);
  field = index + PRODRETEST_TRIM0;

  if ((field < PRODRETEST_TRIM0) || (field > PRODRETEST_TRIM14)) {
    RT_SHELL_PRINTF_ERROR("INVALID Index %d......\n", index);
    return -ENOEXEC;
  }

  err = read_otp_memory(REGION_PROTECT, &val[REGION_PROTECT], 4);
  if (err) {
    RT_SHELL_PRINTF_ERROR("FAILED reading otp memory......\n");
    return -ENOEXEC;
  }

  ret = check_protection(&val[0], REGION_PROTECT, REGION_PROTECT + 1,
                         REGION_PROTECT + 2, REGION_PROTECT + 3);
  disp_location_status("OTP", ret);
  if (ret != OTP_ENABLE_PATTERN && ret != OTP_FRESH_FROM_FAB) {
    RT_SHELL_PRINTF_ERROR("USER Region is not Writeable\n");
    return -ENOEXEC;
  }

  switch (field) {
  case PRODRETEST_TRIM0:
  case PRODRETEST_TRIM1:
  case PRODRETEST_TRIM2:
  case PRODRETEST_TRIM3:
  case PRODRETEST_TRIM4:
  case PRODRETEST_TRIM5:
  case PRODRETEST_TRIM6:
  case PRODRETEST_TRIM7:
  case PRODRETEST_TRIM8:
  case PRODRETEST_TRIM9:
  case PRODRETEST_TRIM10:
  case PRODRETEST_TRIM11:
  case PRODRETEST_TRIM12:
  case PRODRETEST_TRIM13:
  case PRODRETEST_TRIM14:
    if (argc != 3) {
      RT_SHELL_PRINTF_ERROR(
          "invalid # of args for field %d (expected 3) : %d\n", field, argc);
      return -ENOEXEC;
    }
    write_val = strtoul(argv[2], NULL, 0);
    status = write_otp_memory(field, &write_val);
    break;
  default:
    RT_SHELL_PRINTF_ERROR("unsupported field %d\n", field);
    return -ENOEXEC;
  }

  if (!status) {
    RT_SHELL_PRINTF_INFO("Finished Writing Retrim param\n");
  }

  return 0;
}

#ifdef CONFIG_ZEPHYR_SHELL
DEFINE_CMD_HANDLER(nrf_wifi_radio_test_otp_get_status);
DEFINE_CMD_HANDLER(nrf_wifi_radio_test_otp_read_params);
DEFINE_CMD_HANDLER(nrf_wifi_radio_test_otp_read_retrim_version);
DEFINE_CMD_HANDLER(nrf_wifi_radio_test_otp_read_retrim_params);
DEFINE_CMD_HANDLER(nrf_wifi_radio_test_otp_write_params);
DEFINE_CMD_HANDLER(nrf_wifi_radio_test_otp_write_retrim_version);
DEFINE_CMD_HANDLER(nrf_wifi_radio_test_otp_write_retrim_params);

SHELL_STATIC_SUBCMD_SET_CREATE(
    nrf_wifi_radio_otp_subcmds,
    SHELL_CMD_ARG(otp_get_status, NULL, "Read OTP status",
                  RTSH(nrf_wifi_radio_test_otp_get_status), 1, 0),
    SHELL_CMD_ARG(
        otp_read_params, NULL,
        "Read User region status and information on programmed fields",
        RTSH(nrf_wifi_radio_test_otp_read_params), 1, 0),
    SHELL_CMD_ARG(otp_read_retrim_version, NULL, "Read Retrim Version",
                  RTSH(nrf_wifi_radio_test_otp_read_retrim_version), 1, 0),
    SHELL_CMD_ARG(otp_read_retrim_params, NULL, "Read Retrim Params",
                  RTSH(nrf_wifi_radio_test_otp_read_retrim_params), 1, 0),
    SHELL_CMD_ARG(otp_write_params, NULL,
                  "Write OTP Params\n"
                  "otp_write_params <addr offset> [arg1] [arg2]...[argN]",
                  RTSH(nrf_wifi_radio_test_otp_write_params), 2, 16),
    SHELL_CMD_ARG(otp_write_retrim_version, NULL,
                  "Write OTP Retrim Version\n"
                  "otp_write_retrim_version <retrim version>",
                  RTSH(nrf_wifi_radio_test_otp_write_retrim_version), 2, 0),
    SHELL_CMD_ARG(otp_write_retrim_params, NULL,
                  "Write OTP Retrim Params\n"
                  "otp_write_params <retrim index> [retrim data]",
                  RTSH(nrf_wifi_radio_test_otp_write_retrim_params), 3, 0),
    SHELL_SUBCMD_SET_END);

SHELL_CMD_REGISTER(wifi_radio_ficr_prog, &nrf_wifi_radio_otp_subcmds,
                   "nRF Wi-Fi radio FICR commands", NULL);

#endif

static int nrf_wifi_radio_otp_shell_init(void) { return 0; }

SYS_INIT(nrf_wifi_radio_otp_shell_init, APPLICATION,
         CONFIG_APPLICATION_INIT_PRIORITY);
```

## src/nrf_wifi_radio_test_main.c
```c
/*
 * Copyright (c) 2022 Nordic Semiconductor ASA
 *
 * SPDX-License-Identifier: LicenseRef-Nordic-5-Clause
 */

#include <zephyr/kernel.h>

#include "radio_test/nrf70_bm_lib.h"
#include "nrf_wifi_radio_test_shell.h"

#define CHECK_RET(func) do { \
	ret = func; \
	if (ret) { \
		printf("Error: %d\n", ret); \
		goto cleanup; \
	} \
} while (0)

bool debug_enabled;

#define debug_print(fmt, ...) \
	do {if (debug_enabled) printf(fmt, ##__VA_ARGS__); } while (0)

int main(void)
{
	int ret = 0;
	struct nrf70_bm_regulatory_info reg_info = { 0 };

#ifndef CONFIG_ZEPHYR_SHELL
#error "This sample application requires shell support, please enable CONFIG_ZEPHYR_SHELL"
#endif

	memcpy(reg_info.country_code, CONFIG_WIFI_RT_REG_DOMAIN, 2);
	reg_info.force = true;

	/* Initialize the Wi-Fi module */
	CHECK_RET(nrf70_bm_rt_init(&reg_info));
	printf("Initialized WiFi module, ready for radio test\n");

	ret = nrf_wifi_radio_test_shell_init();
	if (ret) {
		printf("Failed to initialize radio test: %d\n", ret);
		goto cleanup;
	}

cleanup:
	if (ret) {
		nrf70_bm_rt_deinit();
		printf("Exiting WiFi radio test sample application with error: %d\n", ret);
	}
	return ret;
}
```
