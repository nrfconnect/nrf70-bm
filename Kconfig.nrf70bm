## Kconfig.nrf70bm
```kconfig
#
# Copyright (c) 2024 Nordic Semiconductor
#
# SPDX-License-Identifier: BSD-3-Clause
#

menu "Nordic nRF70 BM configuration"

rsource "nrf70_zephyr_shim/Kconfig"
rsource "nrf70_bm_lib/Kconfig"

endmenu
```

## nrf70_bm_lib/Kconfig
```kconfig
#
# Copyright (c) 2024 Nordic Semiconductor ASA
#
# SPDX-License-Identifier: BSD-3-Clause
#
menu "Nordic nRF70 BM configuration"

config NRF70_BM_LIB
	bool "Enable nRF70 BM library"
	select NRF_WIFI
	help
	  Enable the nRF70 BM library.

config NRF70_BM_LOG_LEVEL
	int "Log level for nRF70 BM library"
	default 3
	range 0 4
	help
		Log level for nRF70 BM library.

config NRF70_SCAN_SSID_FILT_MAX
	int "Maximum number of SSIDs that can be specified for SSID filtering"
	default 1
	range 1 2
	help
	  Maximum number of SSIDs that can be specified for SSID filtering.
	  This can be set based on the underlying chipsets limitations.

config NRF70_SCAN_CHAN_MAX_MANUAL
	int "Maximum number of channels that can be manually specified"
	range 1 110
	default 3
	help
	  There are approximately 100 channels allocated across the three supported bands.
	  The default of 3 allows the 3 most common channels (2.4GHz: 1, 6, 11) to be specified.

config NRF_WIFI_SCAN_MAX_BSS_CNT
	int "Maximum number of scan results to return."
	default 0
	range 0 65535
	help
	  Maximum number of scan results to return. 0 represents unlimited number of BSSes.

config NRF70_FIXED_MAC_ADDRESS
	string "WiFi Fixed MAC address in format XXXXXXXXXXXX"
	help
	  This overrides the MAC address read from OTP. Strictly for testing purposes only.

choice
	prompt "Wi-Fi MAC address type"
	default NRF70_FIXED_MAC_ADDRESS_ENABLED if NRF70_FIXED_MAC_ADDRESS != ""
	default NRF70_OTP_MAC_ADDRESS
	help
	  Select the type of MAC address to be used by the Wi-Fi driver

config NRF70_OTP_MAC_ADDRESS
	bool "Use MAC address from OTP"
	help
	  This option uses the MAC address stored in the OTP memory of the nRF700x.

config NRF70_FIXED_MAC_ADDRESS_ENABLED
	bool "Enable fixed MAC address"
	help
	  Enable fixed MAC address

config NRF70_RANDOM_MAC_ADDRESS
	bool "Random MAC address generation at runtime"
	help
	  This option enables random MAC address generation at runtime.
	  The random MAC address is generated using the libc srand() function.
endchoice

config NRF70_LOG_VERBOSE
	bool "Maintains the verbosity of information in logs"
	default y

config NRF_WIFI_LOW_POWER
	bool "Enable low power mode in nRF Wi-Fi chipsets"
	default y

config NRF_WIFI_BEAMFORMING
	bool "Enable Wi-Fi beamforming"
	default y
	help
	  Enabling beamforming can provide slight improvement in performance where as disabling
	  it can provide better power saving in low network activity applications

menu "nRF Wi-Fi operation band(s)"
	visible if !NRF70_2_4G_ONLY

config NRF_WIFI_2G_BAND
	bool "Set operation band to 2.4GHz"
	default y if NRF70_2_4G_ONLY

config NRF_WIFI_5G_BAND
	bool "Set operation band to 5GHz"
	depends on !NRF70_2_4G_ONLY

config NRF_WIFI_OP_BAND
	int "Options to set operation band"
	default 1 if NRF_WIFI_2G_BAND
	default 2 if NRF_WIFI_5G_BAND
	default 3
	help
	  Set this option to select frequency band
	  1 - 2.4GHz
	  2 - 5GHz
	  3 - All ( 2.4GHz and 5GHz )
endmenu

config SYSTEM_WORKQUEUE_STACK_SIZE
	default 2560

config NRF70_PCB_LOSS_2G
	int "PCB loss for 2.4 GHz band"
	default 0
	range 0 4
	help
	  Specifies PCB loss from the antenna connector to the RF pin.
	  The values are in dB scale in steps of 1dB and range of 0-4dB.
	  The loss is considered in the RX path only.

config NRF70_PCB_LOSS_5G_BAND1
	int "PCB loss for 5 GHz band (5150 MHz - 5350 MHz, Channel-32 - Channel-68)"
	default 0
	range 0 4
	help
	  Specifies PCB loss from the antenna connector to the RF pin.
	  The values are in dB scale in steps of 1dB and range of 0-4dB.
	  The loss is considered in the RX path only.

config NRF70_PCB_LOSS_5G_BAND2
	int "PCB loss for 5 GHz band (5470 MHz - 5730 MHz, Channel-96 - Channel-144)"
	default 0
	range 0 4
	help
	  Specifies PCB loss from the antenna connector to the RF pin.
	  The values are in dB scale in steps of 1dB and range of 0-4dB.
	  The loss is considered in the RX path only.

config NRF70_PCB_LOSS_5G_BAND3
	int "PCB loss for 5 GHz band (5730 MHz - 5895 MHz, Channel-149 - Channel-177)"
	default 0
	range 0 4
	help
	  Specifies PCB loss from the antenna connector to the RF pin.
	  The values are in dB scale in steps of 1dB and range of 0-4dB.
	  The loss is considered in the RX path only.

config NRF70_ANT_GAIN_2G
	int "Antenna gain for 2.4 GHz band"
	default 0
	range 0 6

config NRF70_ANT_GAIN_5G_BAND1
	int "Antenna gain for 5 GHz band (5150 MHz - 5350 MHz)"
	default 0
	range 0 6

config NRF70_ANT_GAIN_5G_BAND2
	int "Antenna gain for 5 GHz band (5470 MHz - 5730 MHz)"
	default 0
	range 0 6

config NRF70_ANT_GAIN_5G_BAND3
	int "Antenna gain for 5 GHz band (5730 MHz - 5895 MHz)"
	default 0
	range 0 6

config NRF70_BAND_2G_LOWER_EDGE_BACKOFF_DSSS
	int "DSSS Transmit power backoff (in dB) for lower edge of 2.4 GHz frequency band"
	default 0
	range 0 10

config NRF70_BAND_2G_LOWER_EDGE_BACKOFF_HT
	int "HT/VHT Transmit power backoff (in dB) for lower edge of 2.4 GHz frequency band"
	default 0
	range 0 10

config NRF70_BAND_2G_LOWER_EDGE_BACKOFF_HE
	int "HE Transmit power backoff (in dB) for lower edge of 2.4 GHz frequency band"
	default 0
	range 0 10

config NRF70_BAND_2G_UPPER_EDGE_BACKOFF_DSSS
	int "DSSS Transmit power backoff (in dB) for upper edge of 2.4 GHz frequency band"
	default 0
	range 0 10

config NRF70_BAND_2G_UPPER_EDGE_BACKOFF_HT
	int "HT/VHT Transmit power backoff (in dB) for upper edge of 2.4 GHz frequency band"
	default 0
	range 0 10

config NRF70_BAND_2G_UPPER_EDGE_BACKOFF_HE
	int "HE Transmit power backoff (in dB) for upper edge of 2.4 GHz frequency band"
	default 0
	range 0 10

config NRF70_BAND_UNII_1_LOWER_EDGE_BACKOFF_HT
	int "HT/VHT Transmit power backoff (in dB) for lower edge of UNII-1 frequency band"
	default 0
	range 0 10

config NRF70_BAND_UNII_1_LOWER_EDGE_BACKOFF_HE
	int "HE Transmit power backoff (in dB) for lower edge of UNII-1 frequency band"
	default 0
	range 0 10

config NRF70_BAND_UNII_1_UPPER_EDGE_BACKOFF_HT
	int "HT/VHT Transmit power backoff (in dB) for upper edge of UNII-1 frequency band"
	default 0
	range 0 10

config NRF70_BAND_UNII_1_UPPER_EDGE_BACKOFF_HE
	int "HE Transmit power backoff (in dB) for upper edge of UNII-1 frequency band"
	default 0
	range 0 10

config NRF70_BAND_UNII_2A_LOWER_EDGE_BACKOFF_HT
	int "HT/VHT Transmit power backoff (in dB) for lower edge of UNII-2A frequency band"
	default 0
	range 0 10

config NRF70_BAND_UNII_2A_LOWER_EDGE_BACKOFF_HE
	int "HE Transmit power backoff (in dB) for lower edge of UNII-2A frequency band"
	default 0
	range 0 10

config NRF70_BAND_UNII_2A_UPPER_EDGE_BACKOFF_HT
	int "HT/VHT Transmit power backoff (in dB) for upper edge of UNII-2A frequency band"
	default 0
	range 0 10

config NRF70_BAND_UNII_2A_UPPER_EDGE_BACKOFF_HE
	int "HE Transmit power backoff (in dB) for upper edge of UNII-2A frequency band"
	default 0
	range 0 10

config NRF70_BAND_UNII_2C_LOWER_EDGE_BACKOFF_HT
	int "HT/VHT Transmit power backoff (in dB) for lower edge of UNII-2C frequency band"
	default 0
	range 0 10

config NRF70_BAND_UNII_2C_LOWER_EDGE_BACKOFF_HE
	int "HE Transmit power backoff (in dB) for lower edge of UNII-2C frequency band"
	default 0
	range 0 10

config NRF70_BAND_UNII_2C_UPPER_EDGE_BACKOFF_HT
	int "HT/VHT Transmit power backoff (in dB) for upper edge of UNII-2C frequency band"
	default 0
	range 0 10

config NRF70_BAND_UNII_2C_UPPER_EDGE_BACKOFF_HE
	int "HE Transmit power backoff (in dB) for upper edge of UNII-2C frequency band"
	default 0
	range 0 10

config NRF70_BAND_UNII_3_LOWER_EDGE_BACKOFF_HT
	int "HT/VHT Transmit power backoff (in dB) for lower edge of UNII-3 frequency band"
	default 0
	range 0 10

config NRF70_BAND_UNII_3_LOWER_EDGE_BACKOFF_HE
	int "HE Transmit power backoff (in dB) for lower edge of UNII-3 frequency band"
	default 0
	range 0 10

config NRF70_BAND_UNII_3_UPPER_EDGE_BACKOFF_HT
	int "HT/VHT Transmit power backoff (in dB) for upper edge of UNII-3 frequency band"
	default 0
	range 0 10

config NRF70_BAND_UNII_3_UPPER_EDGE_BACKOFF_HE
	int "HE Transmit power backoff (in dB) for upper edge of UNII-3 frequency band"
	default 0
	range 0 10

config NRF70_BAND_UNII_4_LOWER_EDGE_BACKOFF_HT
	int "HT/VHT Transmit power backoff (in dB) for lower edge of UNII-4 frequency band"
	default 0
	range 0 10

config NRF70_BAND_UNII_4_LOWER_EDGE_BACKOFF_HE
	int "HE Transmit power backoff (in dB) for lower edge of UNII-4 frequency band"
	default 0
	range 0 10

config NRF70_BAND_UNII_4_UPPER_EDGE_BACKOFF_HT
	int "HT/VHT Transmit power backoff (in dB) for upper edge of UNII-4 frequency band"
	default 0
	range 0 10

config NRF70_BAND_UNII_4_UPPER_EDGE_BACKOFF_HE
	int "HE Transmit power backoff (in dB) for upper edge of UNII-4 frequency band"
	default 0
	range 0 10

choice "Board type"
	prompt "Select the board type"
	default NRF70_BOARD_TYPE_DK

config NRF70_BOARD_TYPE_DK
	bool "Development Kit"
	help
	  Select this option if the nRF70 is mounted on a development kit.

config NRF70_BOARD_TYPE_EK
	bool "Evaluation Kit"
	help
	  Select this option if the nRF70 is mounted on an evaluation kit.

config NRF70_BOARD_TYPE_CUSTOM
	bool "Custom board"
	help
	  Select this option if the nRF70 is mounted on a custom board.
endchoice

config NRF70_REG_DOMAIN
	string "The ISO/IEC alpha2 country code for the country in which this device is currently operating. Default 00 (World regulatory)"
	# 00 is used for World regulatory
	default "00"

config NRF_WIFI_IFACE_MTU
	int "MTU for Wi-Fi interface"
	range 576 2304 if NET_IPV4
	range 1280 2304 if NET_IPV6
	default 1500

module = WIFI_NRF70
module-dep = LOG
module-str = Log level for Wi-Fi nRF70 driver
module-help = Sets log level for Wi-Fi nRF70 driver
source "subsys/logging/Kconfig.template.log_config"

config WIFI_NRF70_LOG_LEVEL
	# Enable error by default
	default 1

config NRF_WIFI_AP_DEAD_DETECT_TIMEOUT
	int "Access point dead detection timeout in seconds"
	range 1 30
	default 20
	help
		The number of seconds after which the AP is declared dead if no beacons
		are received from the AP. This is used to detect AP silently going down, for example, due to power off.

config NRF70_RX_NUM_BUFS
	int "Number of RX buffers"
	default 3

config NRF70_RX_MAX_DATA_SIZE
	int "Maximum size of RX data"
	default 1600
if NRF_WIFI_LOW_POWER
config NRF70_RPU_PS_IDLE_TIMEOUT_MS
	int "RPU power save idle timeout in milliseconds"
	default 10
endif

config NRF_WIFI_DISPLAY_SCAN_BSS_LIMIT
	# Display scan BSS entries limit
	# By default, the limit is 250 in scan-only mode and 150 in regular mode.
	int "Display scan bss limit"
	range 1 450 if NRF70_SCAN_ONLY
	def_int 250 if NRF70_SCAN_ONLY
	range 1 160
	def_int 150
	help
	  Number of BSS entries in scan result.

choice NRF70_OPER_MODES
	bool "nRF70 operating modes"
	default NRF70_SCAN_ONLY
	help
	  Select the operating mode of the nRF70 driver

config NRF70_SCAN_ONLY
	bool "nRF70 scan only mode"
	help
	  Select this option to enable scan only mode of the nRF70 driver

config NRF70_RADIO_TEST
	bool "Radio test mode of the nRF70 driver"
endchoice

endmenu
```

## nrf70_zephyr_shim/Kconfig
```kconfig
#
# Copyright (c) 2024 Nordic Semiconductor ASA
#
# SPDX-License-Identifier: BSD-3-Clause
#

DT_COMPAT_NORDIC_NRF7002_QSPI := nordic,nrf7002-qspi
DT_COMPAT_NORDIC_NRF7002_SPI := nordic,nrf7002-spi
DT_COMPAT_NORDIC_NRF7001_QSPI := nordic,nrf7001-qspi
DT_COMPAT_NORDIC_NRF7001_SPI := nordic,nrf7001-spi
DT_COMPAT_NORDIC_NRF7000_QSPI := nordic,nrf7000-qspi
DT_COMPAT_NORDIC_NRF7000_SPI := nordic,nrf7000-spi

menuconfig NRF70_ZEPHYR_SHIM
  bool "Enable nRF70 Zephyr shim"
  default y if NRF70_BM_LIB
  # For Random MAC address generation
  select TEST_RANDOM_GENERATOR
  help
    Enable the nRF70 Zephyr shim.

config WIFI_NRF7002
	bool
	default y if DT_HAS_NORDIC_NRF7002_SPI_ENABLED || DT_HAS_NORDIC_NRF7002_QSPI_ENABLED

config WIFI_NRF7001
	bool
	default y if DT_HAS_NORDIC_NRF7001_SPI_ENABLED || DT_HAS_NORDIC_NRF7001_QSPI_ENABLED

config WIFI_NRF7000
	bool
	default y if DT_HAS_NORDIC_NRF7000_SPI_ENABLED || DT_HAS_NORDIC_NRF7000_QSPI_ENABLED

if NRF70_ZEPHYR_SHIM

config NRF70_ON_QSPI
	def_bool $(dt_compat_enabled,$(DT_COMPAT_NORDIC_NRF7002_QSPI)) ||\
			 $(dt_compat_enabled,$(DT_COMPAT_NORDIC_NRF7001_QSPI)) ||\
			 $(dt_compat_enabled,$(DT_COMPAT_NORDIC_NRF7000_QSPI))
	select NRFX_QSPI

config NRF70_ON_SPI
	def_bool $(dt_compat_enabled,$(DT_COMPAT_NORDIC_NRF7002_SPI)) ||\
			 $(dt_compat_enabled,$(DT_COMPAT_NORDIC_NRF7001_SPI)) ||\
			 $(dt_compat_enabled,$(DT_COMPAT_NORDIC_NRF7000_SPI))
	select SPI

module = WIFI_NRF70_SHIM_BUS
module-dep = LOG
module-str = Log level for nR70 Zephyr shim
source "${ZEPHYR_BASE}/subsys/logging/Kconfig.template.log_config"

config WIFI_NRF70_SHIM_BUS_LOG_LEVEL
       # Enable error by default
       default 1

module = WIFI_NRF70_SHIM
module-dep = LOG
module-str = Log level for Wi-Fi nRF700x driver
source "${ZEPHYR_BASE}/subsys/logging/Kconfig.template.log_config"

config WIFI_NRF70_SHIM_LOG_LEVEL
	# Enable error by default
	default 1

config NRF_WIFI_LOW_POWER
	bool "Enable low power mode in nRF Wi-Fi chipsets"
	default y

config NRF70_IRQ_WQ_PRIORITY
  int "Priority of the workqueue for handling IRQs"
  default -15

config NRF70_BH_WQ_PRIORITY
  int "Priority of the workqueue for handling bottom half"
  default 0

config NRF70_IRQ_WQ_STACK_SIZE
  int "Stack size of the workqueue for handling IRQs"
  default 2048

config NRF70_BH_WQ_STACK_SIZE
  int "Stack size of the workqueue for handling bottom half"
  default 2048

config NRF70_WORKQ_STACK_SIZE
  int "Stack size for workqueue"
  default 4096

config NRF70_WORKQ_MAX_ITEMS
  int "Maximum work items for all workqueues"
  default 100

config HEAP_MEM_POOL_SIZE
	default 30000

config NRF70_LOG_VERBOSE
	bool "Maintains the verbosity of information in logs"
	default y
endif # NRF70_ZEPHYR_SHIM
```
